## app/Kconfig
```kconfig
config ZMK_BEHAVIOR_ESC_HOLD
    bool "Escape key with minimum hold"
    default y
    help
      Only sends ESC if held longer than threshold.

config ZMK_ESC_HOLD_THRESHOLD
    int "Minimum hold time in ms"
    default 100
    help
      Escape must be held at least this long to register.
```

## boards/shields/tirouge01/Kconfig.defconfig
```kconfig
if SHIELD_TIROUGE01_LEFT

config ZMK_KEYBOARD_NAME
    default "TiRouge01"

config ZMK_SPLIT_ROLE_CENTRAL
    default y

endif

if SHIELD_TIROUGE01_LEFT || SHIELD_TIROUGE01_RIGHT

config ZMK_SPLIT
    default y

endif
```

## boards/shields/tirouge01/Kconfig.shield
```kconfig
# Copyright (c) 2024 Matt Gilbert
# SPDX-License-Identifier: MIT

config SHIELD_TIROUGE01_LEFT
    def_bool $(shields_list_contains,tirouge01_left)

config SHIELD_TIROUGE01_RIGHT
    def_bool $(shields_list_contains,tirouge01_right)
```

## config/boards/shields/splitkb_tirouge01/Kconfig.defconfig
```kconfig
# Copyright (c) 2022 The ZMK Contributors
# SPDX-License-Identifier: MIT

if SHIELD_SPLITKB_TIROUGE01_LEFT

config ZMK_KEYBOARD_NAME
    default "Ti-Rouge 01"

config ZMK_SPLIT_ROLE_CENTRAL
    default y

endif # SHIELD_SPLITKB_TIROUGE01_LEFT

if SHIELD_SPLITKB_TIROUGE01_LEFT || SHIELD_SPLITKB_TIROUGE01_RIGHT

config ZMK_SPLIT
    default y

endif # SHIELD_SPLITKB_TIROUGE01_LEFT || SHIELD_SPLITKB_TIROUGE01_RIGHT
```

## config/boards/shields/splitkb_tirouge01/Kconfig.shield
```kconfig
config SHIELD_SPLITKB_TIROUGE01_LEFT
    def_bool $(shields_list_contains, splitkb_tirouge01_left)

config SHIELD_SPLITKB_TIROUGE01_RIGHT
    def_bool $(shields_list_contains, splitkb_tirouge01_right)
```

## config/boards/shields/tirouge01/Kconfig.defconfig
```kconfig
# Copyright (c) 2022 The ZMK Contributors
# SPDX-License-Identifier: MIT

if SPLITKB_TIROUGE01_LEFT

config ZMK_KEYBOARD_NAME
    default "Ti-Rouge 01"

config ZMK_SPLIT_ROLE_CENTRAL
    default y

endif # SPLITKB_TIROUGE01_LEFT

if SPLITKB_TIROUGE01_LEFT || SPLITKB_TIROUGE01_RIGHT

config ZMK_SPLIT
    default y

endif # SPLITKB_TIROUGE01_LEFT || SPLITKB_TIROUGE01_RIGHT
```
